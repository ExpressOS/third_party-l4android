## drivers/staging/expressos/Kconfig
```kconfig
menu "ExpressOS"

config EXPRESSOS
       bool "ExpressOS Extensions"
       depends on PROC_FS
       default N
       ---help---
         Enable support for ExpressOS.

if EXPRESSOS

config EXPRESSOS_DRIVER
	tristate "ExpressOS driver"
	default y

endif
endmenu
```
